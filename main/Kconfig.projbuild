## main/Kconfig.projbuild
```kconfig
menu "Greenhouse Device Configuration"

    choice DEVICE_TYPE
        prompt "Device Type"
        default DEVICE_CLIMATE_MONITOR
        help
            Select which device firmware to build.
            Each device type has different functionality and sensors.

        config DEVICE_CLIMATE_MONITOR
            bool "Climate Monitor (BME680)"
            help
                Climate monitoring device with BME680 sensor.
                Measures temperature, humidity, pressure, and air quality.
                Publishes data to MQTT topic: sensor/climate

        config DEVICE_HUMIDIFIER
            bool "Humidifier Controller"
            help
                Controls humidifier based on MQTT commands.
                Monitors humidity and adjusts humidifier output.
                (Not yet implemented)

        config DEVICE_LIGHT_CONTROLLER
            bool "Light Controller"
            help
                Controls grow lights based on MQTT commands.
                Supports scheduling and dimming.
                (Not yet implemented)

    endchoice

    config BROKER_URL
        string "Broker URL"
        default "mqtt://mqtt.eclipseprojects.io"
        help
            URL of the broker to connect to

    config BROKER_URL_FROM_STDIN
        bool
        default y if BROKER_URL = "FROM_STDIN"

    config DEVICE_ID
        string "Device ID"
        default "climate-01"
        help
            Unique identifier for this device.
            Used to distinguish between multiple devices in the greenhouse.
            Examples: climate-01, climate-02, climate-north, climate-south

    config DEVICE_LOCATION_X
        int "Device X Coordinate (cm)"
        default 0
        help
            X coordinate of device location in greenhouse (cm from origin).
            Used for spatial visualization in dashboards.

    config DEVICE_LOCATION_Y
        int "Device Y Coordinate (cm)"
        default 0
        help
            Y coordinate of device location in greenhouse (cm from origin).
            Used for spatial visualization in dashboards.

endmenu
```
